## CMakeLists.txt
```
#
# Copyright (c) 2020 Nordic Semiconductor
#
# SPDX-License-Identifier: LicenseRef-BSD-5-Clause-Nordic
#

cmake_minimum_required(VERSION 3.8.2)

find_package(Zephyr REQUIRED HINTS $ENV{ZEPHYR_BASE})
project(empty_app_core)

target_sources(app PRIVATE src/main.c)
```

## prj.conf
```kconfig
#
# Copyright (c) 2020 Nordic Semiconductor ASA
#
# SPDX-License-Identifier: LicenseRef-BSD-5-Clause-Nordic
#

CONFIG_MAIN_STACK_SIZE=4096
CONFIG_TIMING_FUNCTIONS=y

CONFIG_SPI=y
CONFIG_LED=y
CONFIG_USE_SEGGER_RTT=y
CONFIG_RTT_CONSOLE=y
CONFIG_UART_CONSOLE=n
CONFIG_BOOTLOADER_MCUBOOT=n
CONFIG_DEBUG=y
CONFIG_CBPRINTF_FP_SUPPORT=y

CONFIG_BT=y
CONFIG_BT_PERIPHERAL=y
CONFIG_BT_DEVICE_NAME="ItsyBitsy"
CONFIG_BT_DEVICE_APPEARANCE=833
CONFIG_BT_MAX_CONN=1
CONFIG_BT_MAX_PAIRED=1

# Enable the NUS service
CONFIG_BT_NUS=y

# Enable bonding
CONFIG_BT_SETTINGS=y
CONFIG_FLASH=y
CONFIG_FLASH_PAGE_LAYOUT=y
CONFIG_FLASH_MAP=y
CONFIG_NVS=y
CONFIG_SETTINGS=y
```

## adafruit_itsybitsy_nrf52840.overlay
```dts
&spi1 {
	compatible = "nordic,nrf-spim";
	status = "okay";
	sck-pin = <13>;
	mosi-pin = <15>;
	miso-pin = <20>;
};
```

## src/main.c
```c
/* 
Dank code for the dank people @ nordicsemi
*/

#include <zephyr.h>
#include <sys/printk.h>
#include <drivers/spi.h>
#include <drivers/gpio.h>
#include <timing/timing.h>
#include <device.h>
#include <stdio.h>

#include <bluetooth/bluetooth.h>
#include <bluetooth/uuid.h>
#include <bluetooth/gatt.h>
#include <bluetooth/hci.h>

#include <bluetooth/services/nus.h>

#define DEVICE_NAME CONFIG_BT_DEVICE_NAME
#define DEVICE_NAME_LEN	(sizeof(DEVICE_NAME) - 1)

static struct bt_conn *current_conn;

static const struct bt_data ad[] = {
	BT_DATA_BYTES(BT_DATA_FLAGS, (BT_LE_AD_GENERAL | BT_LE_AD_NO_BREDR)),
	BT_DATA(BT_DATA_NAME_COMPLETE, DEVICE_NAME, DEVICE_NAME_LEN),
};

#define BT_UUID_BEE_VAL \
	BT_UUID_128_ENCODE(0x6e400002, 0xb5a1, 0xf493, 0xe1a9, 0xe52e24dcca9e)

static const struct bt_data sd[] = {
	BT_DATA_BYTES(BT_DATA_UUID128_ALL, BT_UUID_BEE_VAL),
};

#define LED0 6 //13 on the itsybitsy
#define LATCH 3 //27 on the itsybitsy, used to pulse and load the shift registers

#define powerGate1 5 //Arduino 4 on the itsybitsy
#define powerGate2 26 //Arduino 28 on the itsybitsy

#define numberOfGates 24
#define startGate 0
#define endGate 24
#define debeebounce 30
#define outputDelay 60000

unsigned long lastOutput = 0;
unsigned long long current_time;

bool inSensorReading[numberOfGates];
bool outSensorReading[numberOfGates];

bool lastInSensorReading[numberOfGates];
bool lastOutSensorReading[numberOfGates];

bool checkStateIn[numberOfGates];
bool checkStateOut[numberOfGates];

static bool FLAG = 0;

int inCount[numberOfGates];
int outCount[numberOfGates];

unsigned long startInReadingTime[numberOfGates];
unsigned long startOutReadingTime[numberOfGates];

unsigned long inSensorTime[numberOfGates];
unsigned long outSensorTime[numberOfGates];
 
unsigned long lastInFinishedTime[numberOfGates];
unsigned long lastOutFinishedTime[numberOfGates];
  
unsigned long inReadingTimeHigh[numberOfGates];
unsigned long outReadingTimeHigh[numberOfGates];

int inTotal;
int outTotal;

static uint8_t switchBank[6];
static uint8_t oldSwitchBank[6];

int n = 0;

static const struct spi_config spi_cfg = {
	.operation = SPI_OP_MODE_MASTER | SPI_WORD_SET(8) | SPI_TRANSFER_MSB |
		     SPI_MODE_CPOL, //Setting SPI mode 2 
	.frequency = 3000000,
	.slave = 0,
};

const struct device * spi_dev;
const struct device * dev;

static void connected(struct bt_conn *conn, uint8_t err)
{
	char addr[BT_ADDR_LE_STR_LEN];

	if (err) {
		printk("Connection failed (err %u)", err);
		return;
	}

	bt_addr_le_to_str(bt_conn_get_dst(conn), addr, sizeof(addr));
	printk("Connected %.*s\n", BT_ADDR_LE_STR_LEN, addr);

	current_conn = bt_conn_ref(conn);

	//printk("Sending test data\n");

	// char msg[20];
	// uint8_t length = snprintf(msg, 20, "%i,%i\n", outTotal, inTotal);
	// bt_nus_send(current_conn, msg, length);
}

static void disconnected(struct bt_conn *conn, uint8_t reason)
{
	char addr[BT_ADDR_LE_STR_LEN];

	bt_addr_le_to_str(bt_conn_get_dst(conn), addr, sizeof(addr));

	printk("Disconnected: %.*s (reason %u)\n", BT_ADDR_LE_STR_LEN, addr, reason);

	if (current_conn) {
		bt_conn_unref(current_conn);
		current_conn = NULL;
	}
}

static struct bt_conn_cb conn_callbacks = {
	.connected    = connected,
	.disconnected = disconnected,
};

static void bt_receive_cb(struct bt_conn *conn, const uint8_t *const data,
			  uint16_t len)
{
	char addr[BT_ADDR_LE_STR_LEN] = {0};

	bt_addr_le_to_str(bt_conn_get_dst(conn), addr, ARRAY_SIZE(addr));

	printk("Received data from: %.*s\n", BT_ADDR_LE_STR_LEN, addr);

	printk("%.*s\n", len, data);

}

static struct bt_nus_cb nus_cb = {
	.received = bt_receive_cb,
};

void sendData() {
	
    printk("Total out: ");
    printk("%i", outTotal);
    printk("\n");
    printk("Total in: %i\n", inTotal);
	
    if(current_conn){
		//printk("Connected\n");
		uint16_t msg[2] = {outTotal, inTotal};
		bt_nus_send(current_conn, msg, sizeof(msg));
	}
}

void main(void){
	
	bt_conn_cb_register(&conn_callbacks);

	int err = bt_enable(NULL);
	if (err) {
		printk("BLE not enabled, %i\n", err);
	}

	//printk("Bluetooth initialized");

	if (IS_ENABLED(CONFIG_SETTINGS)) {
		settings_load();
	}

	err = bt_nus_init(&nus_cb);
	if (err) {
		printk("Failed to initialize UART service (err: %d)\n", err);
		return;
	}

	err = bt_le_adv_start(BT_LE_ADV_CONN, ad, ARRAY_SIZE(ad), sd,
			      ARRAY_SIZE(sd));
	if (err) {
		printk("Advertising failed to start (err %d)", err);
	}

	const struct device *spi_dev = device_get_binding("SPI_1");
	const struct device * dev = device_get_binding("GPIO_0");
	if (spi_dev == NULL) {
		printk("SPI device not found\n");
		return;
	}
	else if (!dev) {
		printk("Device not found\n");
		return;
	}

	gpio_pin_configure(dev, LATCH, GPIO_OUTPUT); //We need to pulse these shift registers to read them
	gpio_pin_configure(dev, powerGate1, GPIO_OUTPUT);
	gpio_pin_configure(dev, powerGate2, GPIO_OUTPUT);
	gpio_pin_configure(dev, LED0, GPIO_OUTPUT); //LED pin is 6, one could use aliases here
	gpio_pin_configure(dev, 2, GPIO_OUTPUT_INACTIVE);
	gpio_pin_configure(dev, 14, GPIO_OUTPUT_INACTIVE);
	gpio_pin_configure(dev, 16, GPIO_OUTPUT_INACTIVE);

	while(1){
		current_time = k_uptime_get();
		static uint8_t rx_buffer[6]; //6 shift registers requires an array with length 6

		struct spi_buf rx_buf = {
			.buf = rx_buffer,
			.len = sizeof(rx_buffer),
		};
		const struct spi_buf_set rx = {
			.buffers = &rx_buf,
			.count = 1
		};
		
		int err;

		gpio_pin_set(dev, powerGate1, 1);
		gpio_pin_set(dev, powerGate2, 1);

		k_usleep(75); //Setting first 24 gates takes ~ 15us, while the gates closer to the end takes ~40-75us. This needs to be verified.

		gpio_pin_set(dev, LATCH, 0);
		k_usleep(3);
		gpio_pin_set(dev, LATCH, 1);

		k_usleep(3);

		gpio_pin_set(dev, powerGate1, 0);
		gpio_pin_set(dev, powerGate2, 0);

		err = spi_read(spi_dev, &spi_cfg, &rx);
		 	if (err)
			{
				printk("SPI error: %d\n", err);
			}
			else{

				for (int i = 0; i < sizeof(switchBank); i++){
					switchBank[i] = rx_buffer[i];
					if (switchBank[i] != oldSwitchBank[i]){
						FLAG = 1;
					}
				}
			}
		
		if (FLAG)
		{
			//Converting bytes to get values
			int gate = 0;
			for (int d = 0; d < sizeof(switchBank); d++)
			{
				for (int i = 0; i < 8; i++)
				{
					if ((switchBank[d] >> i) & 1)
						outSensorReading[gate] = true;
					else outSensorReading[gate] = false;
					i++;
					if ((switchBank[d] >> i) & 1)
						inSensorReading[gate] = true;
					else inSensorReading[gate] = false;
					gate++;
				}
			}
		for (int i = 0; i < sizeof(switchBank); i++){
			oldSwitchBank[i]=switchBank[i];
			FLAG = 0;
			}
		}

		for (int i = startGate; i < endGate; i++) 
		{ 
			if(inSensorReading[i] == true || outSensorReading[i] == true) //Turns on LED when a sensor is activated
			{
		  		gpio_pin_set(dev, LED0, 1);
		   		break;
			}
		 	gpio_pin_set(dev, LED0, 0);
		}
		for (int i = startGate; i < endGate; i++) 
		{ 
		 	if(inSensorReading[i] != lastInSensorReading[i])  //change of state on IN sensor
		 	{ 
		   		checkStateIn[i] = false;
		   		lastInSensorReading[i] = inSensorReading[i];
		   		inSensorTime[i] = current_time;
		 	} 
		 	if(outSensorReading[i] != lastOutSensorReading[i])  //change of state on OUT sensor
		 	{ 
		   		checkStateOut[i] = false;
		   		lastOutSensorReading[i] = outSensorReading[i];
		   		outSensorTime[i] = current_time;
			}    

		 	if(((current_time - inSensorTime[i]) > debeebounce) && (checkStateIn[i] == 0))
			{  //debounce IN sensor
		   		checkStateIn[i] = 1; //passed debounce      
		   		if(inSensorReading[i] == true) //a bee just entered the sensor
		   		{
					startInReadingTime[i] = current_time;
		   		}
		   		if(inSensorReading[i] == false)  //a bee just exits the sensor; that is, it was 1, now it is 0 (empty)
		   		{  
					lastInFinishedTime[i] = current_time;            
		   	  		inReadingTimeHigh[i] = current_time - startInReadingTime[i]; //this variable is how long the bee was present for
					/*
		   	  		printk("%i", i);
		   	  		printk(", IT ,");
		   	  		printk("%ld", inReadingTimeHigh[i]);
		   	  		printk(", ");
					*/
		   	  		if(outReadingTimeHigh[i] < 650 && inReadingTimeHigh[i] < 650)
					{ //should be less than 650ms
		   	    		if((current_time - lastOutFinishedTime[i]) < 200){ //the sensors are pretty cose together so the time it takes to trigger on and then the other should be small.. ~200ms
		   	     			outTotal++;
							/*
		   	     			printk("%lld", current_time);
		   	     			printk(",");
		   	     			printk("1\n");
							*/
		   	    	 	}else{
		   	      		//printk("%lld\n", current_time);
						break; 
		   	     		}
		   	  		}else{
		   	   		//printk("%lld\n", current_time);
					break; 
		   	  		}
		   		}           
			}
			if((current_time - outSensorTime[i]) > debeebounce && checkStateOut[i] == 0)  //debounce OUT sensor
			{
			  checkStateOut[i] = 1; //passed debounce         
			  if(outSensorReading[i] == 1) //a bee just entered the sensor
			  {
			   	startOutReadingTime[i] = current_time;
			  }
			  if(outSensorReading[i] == 0)  //a bee just exits the sensor; that is, it was HIGH, now it is LOW (empty)
			  {  
			  		lastOutFinishedTime[i] = current_time;
			  		outReadingTimeHigh[i] = (current_time- startOutReadingTime[i]); //this variable is how long the bee was present for
					/*
			  		printk("%i", i);
			  		printk(", OT ,");
			  		printk("%ld", outReadingTimeHigh[i]);
			  		printk(", ");
				    */
			  		if((outReadingTimeHigh[i] < 600) && (inReadingTimeHigh[i] < 600)) //should be less than 600ms
					{ 
			  		   	if((current_time - lastInFinishedTime[i]) < 200){ //the sensors are pretty cose together so this time should be small
			  		     	inTotal++;
							/*
			  		 		printk("%lld\n", current_time);
			  		     	printk(",");
			  		    	printk("1\n");
							*/
			  			}else{
			  		    //printk("%lld\n", current_time);
						break; 
			  		   	}
			  		}else{
					//printk("%lld\n", current_time);
					break;
			  		}
			   }          
			}        
		}

		k_msleep(15);   // debounce

		if ((current_time - lastOutput) > outputDelay) 
		{
			//printk("sending data\n");
			sendData(); 
			lastOutput = current_time; 
			inTotal = 0;
			outTotal = 0; 
 	 	}
		
	}
}
```
