## Legacy_Modules/old_submodules/Thingy91/add_this_to_nrf_board/thingy91_nrf52840/Kconfig
```kconfig
# Thingy:91 nRF52840 board configuration
#
# Copyright (c) 2019 Nordic Semiconductor ASA
#
# SPDX-License-Identifier: LicenseRef-Nordic-5-Clause

if BOARD_THINGY91_NRF52840

config BOARD_ENABLE_DCDC
	bool "Enable DCDC mode"
	select SOC_DCDC_NRF52X
	default y

config BOARD_THINGY91_NRF52840_RESET
	bool "Enable GPIO reset line"
	default y
	help
	  Let the nRF52840 be reset from the nRF9160 via a GPIO line.
	  The GPIO line may only be one of the first 6 MCU interface pins.
	  The line is active high.

	
module = BOARD_THINGY91
module-str = Board Control
source "subsys/logging/Kconfig.template.log_config"


endif # BOARD_THINGY91_NRF52840
```

## Legacy_Modules/old_submodules/Thingy91/add_this_to_nrf_board/thingy91_nrf9160/Kconfig
```kconfig
# Thingy:91 nRF9160 board configuration
#
# Copyright (c) 2019 Nordic Semiconductor ASA
#
# SPDX-License-Identifier: LicenseRef-Nordic-5-Clause

if BOARD_THINGY91_NRF9160 || BOARD_THINGY91_NRF9160NS

config BOARD_NRF52840_GPIO_RESET
        bool "Use nRF52840 PCA10090 GPIO reset pin"
	default y if BT_H4
        help
          Use a GPIO pin to reset the nRF52840 controller and let it wait
          until all bytes traveling to the H4 device have been received
          and drained, thus ensuring communication can begin correctly.

endif # BOARD_THINGY91_NRF9160 || BOARD_THINGY91_NRF9160NS

module=BOARD
module-dep=LOG
module-str=Log level for board
source "${ZEPHYR_BASE}/subsys/logging/Kconfig.template.log_config"
```

## MachineLearning_testing/build/Kconfig/Kconfig.modules
```kconfig
menu "nrf (C:\ncs\nrf)"
osource "C:/ncs/nrf/Kconfig.nrf"
config ZEPHYR_NRF_MODULE
	bool
	default y
endmenu
menu "mcuboot (C:\ncs\bootloader\mcuboot)"
osource "$(ZEPHYR_MCUBOOT_KCONFIG)"
config ZEPHYR_MCUBOOT_MODULE
	bool
	default y
endmenu
menu "nrfxlib (C:\ncs\nrfxlib)"
osource "C:/ncs/nrfxlib/Kconfig.nrfxlib"
config ZEPHYR_NRFXLIB_MODULE
	bool
	default y
endmenu
menu "hal_nordic (C:\ncs\modules\hal\nordic)"
osource "$(ZEPHYR_HAL_NORDIC_KCONFIG)"
config ZEPHYR_HAL_NORDIC_MODULE
	bool
	default y
endmenu
menu "cddl-gen (C:\ncs\modules\lib\cddl-gen)"
osource "$(ZEPHYR_CDDL_GEN_KCONFIG)"
config ZEPHYR_CDDL_GEN_MODULE
	bool
	default y
endmenu
menu "connectedhomeip (C:\ncs\modules\lib\connectedhomeip)"
osource "C:/ncs/modules/lib/connectedhomeip/config/nrfconnect/chip-module/Kconfig"
config ZEPHYR_CONNECTEDHOMEIP_MODULE
	bool
	default y
endmenu
```

## Thingy91/src/modules/Kconfig.ble_module
```kconfig
#
# Copyright (c) 2021 Nordic Semiconductor
#
# SPDX-License-Identifier: LicenseRef-Nordic-5-Clause
#

menuconfig BLE_MODULE
	bool "Bluetooth module"
	default y

if BLE_MODULE

config BT_NUS_SECURITY_ENABLED
	bool "Enable security"
	default y
	select BT_SMP
	help
	  "Enable BLE security for the UART service"

endif

module = BLE_MODULE
module-str = Bluetooth module
source "subsys/logging/Kconfig.template.log_config"
```

## bee_counter/adafruit_itsybitsy_nrf52840/Kconfig
```kconfig
# Adafruit Itsybitsy nRF52840 Express board configuration

# Copyright (c) 2021 Nordic Semiconductor ASA
# SPDX-License-Identifier: Apache-2.0

config BOARD_ENABLE_DCDC
	bool "Enable DCDC mode"
	select SOC_DCDC_NRF52X
	default y
	depends on BOARD_ADAFRUIT_ITSYBITSY_NRF52840
```

## bee_counter/adafruit_itsybitsy_nrf52840/Kconfig.board
```kconfig
# Adafruit Itsybitsy nRF52840 Express board configuration

# Copyright (c) 2021 Nordic Semiconductor ASA
# SPDX-License-Identifier: Apache-2.0

config BOARD_ADAFRUIT_ITSYBITSY_NRF52840
	bool "Adafruit Itsybitsy nRF52840 Express"
	depends on SOC_NRF52840_QIAA
```

## bee_counter/adafruit_itsybitsy_nrf52840/Kconfig.defconfig
```kconfig
# Adafruit Itsybitsy nRF52840 Express board configuration

# Copyright (c) 2021 Nordic Semiconductor ASA
# SPDX-License-Identifier: Apache-2.0

if BOARD_ADAFRUIT_ITSYBITSY_NRF52840

config BOARD
	default "adafruit_itsybitsy_nrf52840"

if USB

config USB_NRFX
	default y

config USB_DEVICE_STACK
	default y

endif # USB

config BT_CTLR
	default BT

endif # BOARD_ADAFRUIT_ITSYBITSY_NRF52840
```

## timeThing/build/mcuboot/Kconfig/Kconfig.modules
```kconfig
menu "nrf (C:/ncs/nrf)"
osource "C:/ncs/nrf/Kconfig.nrf"
config ZEPHYR_NRF_MODULE
	bool
	default y
endmenu
menu "mcuboot (C:/ncs/bootloader/mcuboot)"
osource "$(ZEPHYR_MCUBOOT_KCONFIG)"
config ZEPHYR_MCUBOOT_MODULE
	bool
	default y
endmenu
menu "mbedtls (C:/ncs/mbedtls)"
osource "$(ZEPHYR_MBEDTLS_KCONFIG)"
config ZEPHYR_MBEDTLS_MODULE
	bool
	default y
endmenu
menu "trusted-firmware-m (C:/ncs/modules/tee/tf-m/trusted-firmware-m)"
osource "$(ZEPHYR_TRUSTED_FIRMWARE_M_KCONFIG)"
config ZEPHYR_TRUSTED_FIRMWARE_M_MODULE
	bool
	default y
endmenu
menu "cjson (C:/ncs/modules/lib/cjson)"
osource "$(ZEPHYR_CJSON_KCONFIG)"
config ZEPHYR_CJSON_MODULE
	bool
	default y
endmenu
menu "cddl-gen (C:/ncs/modules/lib/cddl-gen)"
osource "$(ZEPHYR_CDDL_GEN_KCONFIG)"
config ZEPHYR_CDDL_GEN_MODULE
	bool
	default y
endmenu
menu "memfault-firmware-sdk (C:/ncs/modules/lib/memfault-firmware-sdk)"
osource "C:/ncs/modules/lib/memfault-firmware-sdk/ports/zephyr/Kconfig"
config ZEPHYR_MEMFAULT_FIRMWARE_SDK_MODULE
	bool
	default y
endmenu
menu "CANopenNode (C:/ncs/modules/lib/canopennode)"
osource "$(ZEPHYR_CANOPENNODE_KCONFIG)"
config ZEPHYR_CANOPENNODE_MODULE
	bool
	default y
endmenu
menu "hal_nordic (C:/ncs/modules/hal/nordic)"
osource "$(ZEPHYR_HAL_NORDIC_KCONFIG)"
config ZEPHYR_HAL_NORDIC_MODULE
	bool
	default y
endmenu
menu "loramac-node (C:/ncs/modules/lib/loramac-node)"
osource "$(ZEPHYR_LORAMAC_NODE_KCONFIG)"
config ZEPHYR_LORAMAC_NODE_MODULE
	bool
	default y
endmenu
menu "lz4 (C:/ncs/modules/lib/lz4)"
osource "$(ZEPHYR_LZ4_KCONFIG)"
config ZEPHYR_LZ4_MODULE
	bool
	default y
endmenu
menu "mbedtls (C:/ncs/modules/crypto/mbedtls)"
osource "$(ZEPHYR_MBEDTLS_KCONFIG)"
config ZEPHYR_MBEDTLS_MODULE
	bool
	default y
endmenu
menu "nanopb (C:/ncs/modules/lib/nanopb)"
osource "$(ZEPHYR_NANOPB_KCONFIG)"
config ZEPHYR_NANOPB_MODULE
	bool
	default y
endmenu
menu "TraceRecorder (C:/ncs/modules/debug/TraceRecorder)"
osource "C:/ncs/modules/debug/TraceRecorder/kernelports/Zephyr/Kconfig"
config ZEPHYR_TRACERECORDER_MODULE
	bool
	default y
endmenu
menu "zscilib (C:/ncs/modules/lib/zscilib)"
osource "C:/ncs/modules/lib/zscilib/Kconfig.zscilib"
config ZEPHYR_ZSCILIB_MODULE
	bool
	default y
endmenu
menu "nrfxlib (C:/ncs/nrfxlib)"
osource "C:/ncs/nrfxlib/Kconfig.nrfxlib"
config ZEPHYR_NRFXLIB_MODULE
	bool
	default y
endmenu
menu "connectedhomeip (C:/ncs/modules/lib/matter)"
osource "C:/ncs/modules/lib/matter/config/nrfconnect/chip-module/Kconfig"
config ZEPHYR_CONNECTEDHOMEIP_MODULE
	bool
	default y
endmenu
```

## v2.0Woodpecker/build/Kconfig/Kconfig.modules
```kconfig
menu "nrf (/home/moho/ncs/nrf)"
osource "/home/moho/ncs/nrf/Kconfig.nrf"
config ZEPHYR_NRF_MODULE
	bool
	default y
endmenu
menu "mcuboot (/home/moho/ncs/bootloader/mcuboot)"
osource "$(ZEPHYR_MCUBOOT_KCONFIG)"
config ZEPHYR_MCUBOOT_MODULE
	bool
	default y
endmenu
menu "mbedtls (/home/moho/ncs/modules/crypto/mbedtls)"
osource "$(ZEPHYR_MBEDTLS_KCONFIG)"
config ZEPHYR_MBEDTLS_MODULE
	bool
	default y
endmenu
menu "trusted-firmware-m (/home/moho/ncs/modules/tee/tf-m/trusted-firmware-m)"
osource "$(ZEPHYR_TRUSTED_FIRMWARE_M_KCONFIG)"
config ZEPHYR_TRUSTED_FIRMWARE_M_MODULE
	bool
	default y
endmenu
menu "cjson (/home/moho/ncs/modules/lib/cjson)"
osource "$(ZEPHYR_CJSON_KCONFIG)"
config ZEPHYR_CJSON_MODULE
	bool
	default y
endmenu
menu "zcbor (/home/moho/ncs/modules/lib/zcbor)"
osource "$(ZEPHYR_ZCBOR_KCONFIG)"
config ZEPHYR_ZCBOR_MODULE
	bool
	default y
endmenu
menu "memfault-firmware-sdk (/home/moho/ncs/modules/lib/memfault-firmware-sdk)"
osource "/home/moho/ncs/modules/lib/memfault-firmware-sdk/ports/zephyr/Kconfig"
config ZEPHYR_MEMFAULT_FIRMWARE_SDK_MODULE
	bool
	default y
endmenu
menu "canopennode (/home/moho/ncs/modules/lib/canopennode)"
osource "$(ZEPHYR_CANOPENNODE_KCONFIG)"
config ZEPHYR_CANOPENNODE_MODULE
	bool
	default y
endmenu
menu "chre (/home/moho/ncs/modules/lib/chre)"
osource "/home/moho/ncs/modules/lib/chre/platform/zephyr/Kconfig"
config ZEPHYR_CHRE_MODULE
	bool
	default y
endmenu
menu "hal_nordic (/home/moho/ncs/modules/hal/nordic)"
osource "$(ZEPHYR_HAL_NORDIC_KCONFIG)"
config ZEPHYR_HAL_NORDIC_MODULE
	bool
	default y
endmenu
menu "liblc3codec (/home/moho/ncs/modules/lib/liblc3codec)"
osource "$(ZEPHYR_LIBLC3CODEC_KCONFIG)"
config ZEPHYR_LIBLC3CODEC_MODULE
	bool
	default y
endmenu
menu "littlefs (/home/moho/ncs/modules/fs/littlefs)"
osource "$(ZEPHYR_LITTLEFS_KCONFIG)"
config ZEPHYR_LITTLEFS_MODULE
	bool
	default y
endmenu
menu "loramac-node (/home/moho/ncs/modules/lib/loramac-node)"
osource "$(ZEPHYR_LORAMAC_NODE_KCONFIG)"
config ZEPHYR_LORAMAC_NODE_MODULE
	bool
	default y
endmenu
menu "lvgl (/home/moho/ncs/modules/lib/gui/lvgl)"
osource "/home/moho/ncs/modules/lib/gui/lvgl/zephyr/Kconfig"
config ZEPHYR_LVGL_MODULE
	bool
	default y
endmenu
menu "lz4 (/home/moho/ncs/modules/lib/lz4)"
osource "$(ZEPHYR_LZ4_KCONFIG)"
config ZEPHYR_LZ4_MODULE
	bool
	default y
endmenu
menu "nanopb (/home/moho/ncs/modules/lib/nanopb)"
osource "$(ZEPHYR_NANOPB_KCONFIG)"
config ZEPHYR_NANOPB_MODULE
	bool
	default y
endmenu
menu "TraceRecorder (/home/moho/ncs/modules/debug/TraceRecorder)"
osource "/home/moho/ncs/modules/debug/TraceRecorder/kernelports/Zephyr/Kconfig"
config ZEPHYR_TRACERECORDER_MODULE
	bool
	default y
endmenu
menu "zscilib (/home/moho/ncs/modules/lib/zscilib)"
osource "/home/moho/ncs/modules/lib/zscilib/Kconfig.zscilib"
config ZEPHYR_ZSCILIB_MODULE
	bool
	default y
endmenu
menu "nrfxlib (/home/moho/ncs/nrfxlib)"
osource "/home/moho/ncs/nrfxlib/Kconfig.nrfxlib"
config ZEPHYR_NRFXLIB_MODULE
	bool
	default y
endmenu
menu "connectedhomeip (/home/moho/ncs/modules/lib/matter)"
osource "/home/moho/ncs/modules/lib/matter/config/nrfconnect/chip-module/Kconfig"
config ZEPHYR_CONNECTEDHOMEIP_MODULE
	bool
	default y
endmenu
```

## v2.0Woodpecker/build/Kconfig/Kconfig.shield
```kconfig
osource "/home/moho/Documents/nRF-Beehavior-Firmware/v2.0Woodpecker/boards/shields/*/Kconfig.shield"
osource "/home/moho/ncs/nrf/boards/shields/*/Kconfig.shield"
```

## v2.0Woodpecker/build/Kconfig/Kconfig.shield.defconfig
```kconfig
osource "/home/moho/Documents/nRF-Beehavior-Firmware/v2.0Woodpecker/boards/shields/*/Kconfig.defconfig"
osource "/home/moho/ncs/nrf/boards/shields/*/Kconfig.defconfig"
```
