## prj.conf
```kconfig
CONFIG_GPIO=y

# enable c++ support

CONFIG_CPLUSPLUS=y

CONFIG_LIB_CPLUSPLUS=y

CONFIG_NEWLIB_LIBC=y

CONFIG_NEWLIB_LIBC_FLOAT_PRINTF=y



# enable reboot from user space

CONFIG_REBOOT=y



CONFIG_FPU=y

CONFIG_MAIN_STACK_SIZE=8192



# serial console

CONFIG_SERIAL=y

CONFIG_UART_INTERRUPT_DRIVEN=y

CONFIG_CONSOLE_SUBSYS=n

CONFIG_CONSOLE_GETCHAR=n



# i2c configuration for accelerometer

CONFIG_I2C=y

CONFIG_I2C_NRFX=y



# enable PDM driver


CONFIG_AUDIO=y




CONFIG_ASSERT=y

CONFIG_DEBUG=y

CONFIG_LOG=y




# External Flash memory

CONFIG_FLASH=y

CONFIG_FLASH_PAGE_LAYOUT=y

CONFIG_MPU_ALLOW_FLASH_WRITE=y

CONFIG_NORDIC_QSPI_NOR=y

CONFIG_NORDIC_QSPI_NOR_FLASH_LAYOUT_PAGE_SIZE=4096



# Enable the UART driver

# CONFIG_UART_ASYNC_API=y

# CONFIG_NRFX_UARTE0=y

# CONFIG_UART_CONSOLE=y



CONFIG_HEAP_MEM_POOL_SIZE=2048



CONFIG_BT=y

CONFIG_BT_PERIPHERAL=y

CONFIG_BT_DEVICE_NAME="EdgeImpulse"

CONFIG_BT_DEVICE_APPEARANCE=833

CONFIG_BT_MAX_CONN=1

CONFIG_BT_MAX_PAIRED=1



# Enable the NUS service


CONFIG_BT_NUS_SECURITY_ENABLED=n



# Enable bonding

CONFIG_BT_SETTINGS=y

CONFIG_FLASH=y

CONFIG_FLASH_PAGE_LAYOUT=y

CONFIG_FLASH_MAP=y

CONFIG_NVS=y

CONFIG_SETTINGS=y



# Enable DK LED and Buttons library



# This example requires more workqueue stack

CONFIG_SYSTEM_WORKQUEUE_STACK_SIZE=8192



# Config logger

CONFIG_LOG=y

CONFIG_USE_SEGGER_RTT=y

CONFIG_LOG_BACKEND_RTT=y

CONFIG_LOG_BACKEND_UART=n



CONFIG_ASSERT=y



#added by Nora, both for deep sleep and to get the actual time from nrf91

CONFIG_PM=y



# # Required to disable default behavior of deep sleep on timeout



CONFIG_PM_DEVICE=y

#CONFIG_PM_DEVICE_RUNTIME=y

#for å få klokkeslett

#CONFIG_DATE_TIME=y

#CONFIG_DATE_TIME_MODEM=y

#dette for å få d til å kjøre

#CONFIG_LEGACY_TIMEOUT_API=y
```

## src/main.cpp
```c
#include <zephyr.h>
//#include "ei_run_classifier.h"
#include "numpy.hpp"

#include <sys/printk.h>
#include "ei_device_nordic_nrf52.h"
#include "ei_zephyr_flash_commands.h"
#include "ei_main.h"
#include "ei_run_impulse.h"


int main(void)
{
    /* This is needed so that output of printf 
       is output immediately without buffering 
    */

    setvbuf(stdout, NULL, _IONBF, 0);

    /* Initialize board uart */
    if(uart_init() != 0){
        ei_printf("Init uart on board error occured\r\n");
    }

    /** Initialize development board LEDs */
    if(BOARD_ledInit() != 0){
        ei_printf("Init LEDs on board error occured\r\n");
    }

    /* Initialize Zephyr flash device */
    create_flash_device();

    /* Initialize Edge Impuls sensors and commands */
    ei_init();

    //making it sleep at night
    

    
    MakingSysSleepNight(1400);
    MakingSysSleepNight(2000);
    k_sleep(K_MSEC(2));
    
    

    while(1){
        ei_main();
    }
}
```
