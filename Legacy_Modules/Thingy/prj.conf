## prj.conf
```kconfig
#
# Copyright (c) 2020 Nordic Semiconductor ASA
#
# SPDX-License-Identifier: LicenseRef-Nordic-5-Clause
#
CONFIG_EVENT_MANAGER=y
CONFIG_LINKER_ORPHAN_SECTION_PLACE=y

# Button support
CONFIG_DK_LIBRARY=y

# Enable logging
CONFIG_LOG=y
CONFIG_LOG_DEFAULT_LEVEL=4
#CONFIG_APP_MODULE_LOG_LEVEL_DBG=y

# NewLib C
CONFIG_NEWLIB_LIBC=y

# Enable Bluetooth stack and libraries
CONFIG_BT=y
CONFIG_BT_H4=y
CONFIG_BT_WAIT_NOP=y
CONFIG_BT_CENTRAL=y
CONFIG_BT_SMP=y
CONFIG_BT_GATT_CLIENT=y
CONFIG_BT_MAX_CONN=2  
CONFIG_BT_MAX_PAIRED=2
CONFIG_BT_CONN_CTX=y

# Enable the BLE modules from NCS
CONFIG_BT_NUS_CLIENT=y
CONFIG_BT_SCAN=y
CONFIG_BT_SCAN_FILTER_ENABLE=y
CONFIG_BT_SCAN_UUID_CNT=1
CONFIG_BT_SCAN_NAME_CNT=1
CONFIG_BT_GATT_DM=y

CONFIG_BT_L2CAP_TX_MTU=247
CONFIG_BT_HCI_ACL_FLOW_CONTROL=y
CONFIG_UART_INTERRUPT_DRIVEN=y

# This example requires more workqueue stack
#CONFIG_SYSTEM_WORKQUEUE_STACK_SIZE=2048

# Enable bonding
CONFIG_BT_SETTINGS=y
CONFIG_FLASH=y
CONFIG_FLASH_PAGE_LAYOUT=y
CONFIG_FLASH_MAP=y
CONFIG_NVS=y
CONFIG_SETTINGS=y

# Heap and stacks
CONFIG_HEAP_MEM_POOL_SIZE=16384
CONFIG_MAIN_STACK_SIZE=8192

#Added from peripheral_uart
# Enable the UART driver
CONFIG_UART_ASYNC_API=y
CONFIG_NRFX_UARTE0=y
CONFIG_SERIAL=y

#
# Copyright (c) 2020 Nordic Semiconductor ASA
#
# SPDX-License-Identifier: LicenseRef-Nordic-5-Clause
#

# General config
CONFIG_NEWLIB_LIBC=y
CONFIG_NEWLIB_LIBC_FLOAT_PRINTF=y
CONFIG_RESET_ON_FATAL_ERROR=n
CONFIG_NCS_SAMPLES_DEFAULTS=y

# Network
CONFIG_NETWORKING=y
CONFIG_NET_NATIVE=n
CONFIG_NET_SOCKETS=y
CONFIG_NET_SOCKETS_OFFLOAD=y

# LTE link control
CONFIG_LTE_LINK_CONTROL=y
CONFIG_LTE_NETWORK_MODE_LTE_M=y
CONFIG_LTE_AUTO_INIT_AND_CONNECT=n

# Modem library
CONFIG_NRF_MODEM_LIB=y
# Disable Modem traces, since we need UART1 for HCI
CONFIG_NRF_MODEM_LIB_TRACE_ENABLED=n #Hella sus

# DK
CONFIG_DK_LIBRARY=y

# AT commands interface
CONFIG_UART_INTERRUPT_DRIVEN=y
CONFIG_AT_HOST_LIBRARY=y

# Generic cloud API
CONFIG_CLOUD_API=y

# Selected cloud backend
#CONFIG_CLOUD_BACKEND="NRF_CLOUD"

# nRF Cloud
CONFIG_NRF_CLOUD=y
CONFIG_NRF_CLOUD_CONNECTION_POLL_THREAD=y

# MQTT
CONFIG_MQTT_KEEPALIVE=1200

# Heap and stacks
# Extended memory heap size needed for encoding nRF Cloud messages to JSON
#CONFIG_HEAP_MEM_POOL_SIZE=8192
#CONFIG_MAIN_STACK_SIZE=4096
#Orginalt(og default) 2048
CONFIG_SYSTEM_WORKQUEUE_STACK_SIZE=8192

# Settings, used by nRF Cloud library.
CONFIG_SETTINGS=y
CONFIG_SETTINGS_FCB=y
CONFIG_FCB=y

# Flash storage, used by settings.
CONFIG_MPU_ALLOW_FLASH_WRITE=y

# CONFIG_ZERO_LATENCY_IRQS=n

# CONFIG_LTE_LOCK_BANDS=y
# # Enable band 2, 3, 4, 8, 12, 13 ,20 and 28
# CONFIG_LTE_LOCK_BAND_MASK="1000000010000001100010001110"

CONFIG_RESET_ON_FATAL_ERROR=y
CONFIG_REBOOT=y
```

## src/main.c
```c
/*
 * Copyright (c) 2018 Nordic Semiconductor ASA
 *
 * SPDX-License-Identifier: LicenseRef-Nordic-5-Clause
 */
#define MODULE app_module

#include <zephyr.h>
#include <stdio.h>
#include <drivers/uart.h>
#include <string.h>
#include <logging/log.h>
#include <dk_buttons_and_leds.h>

#include <settings/settings.h>

#include <event_manager.h>

#include "events/ble_event.h"
#include "events/cloud_event.h"

#include "modules/ble_module.h"

#include "battery_monitor/battery_monitor.h"

#include "cJSON.h"

LOG_MODULE_REGISTER(MODULE, CONFIG_APPLICATION_MODULE_LOG_LEVEL);

bool led_on;

static bool event_handler(const struct event_header *eh)
{
	/*if (is_ble_event(eh)) {

		struct ble_event *event = cast_ble_event(eh);

		//char addr[17] = event->address;

		LOG_INF("Address: %s",event->address);

		return false;
	}*/
	
	// if (is_cloud_event_abbr(eh)) {

	// 	struct cloud_event_abbr *event = cast_cloud_event_abbr(eh);
	// 	cJSON *obj = NULL;
	// 	obj = cJSON_Parse(event->dyndata.data);
	// 	cJSON *message = cJSON_GetObjectItem(obj, "message");
	// 	if(message!=NULL){
	// 		if(message->valuestring!=NULL){
	// 			if(message->valuestring[0]=='*'){
	// 				LOG_INF("Should be sent to BLE");
	// 				struct ble_event *ble_event_routed = new_ble_event(strlen(message->valuestring));

	// 				ble_event_routed->type = BLE_SEND;
					
	// 				// char *address_ptr = "Placeholder"; //Finne ut hvordan man kan velge mellom to devicer.
	// 				// char address_temp[17];
	// 				// for(int i=0;i<17;i++){
	// 				// 	address_temp[i]=address_ptr[i];
	// 				// }
	// 				char addr[2];
	// 				addr[0]=message->valuestring[0];
	// 				addr[1]=message->valuestring[1];
	// 				// ble_event->address = address_temp;
	// 				memcpy(ble_event_routed->address, addr, 2);

	// 				memcpy(ble_event_routed->dyndata.data, message->valuestring, strlen(message->valuestring));

	// 				EVENT_SUBMIT(ble_event_routed);
	// 				return false;
	// 			}
	// 			if(!strcmp(message->valuestring, "StartScan")){
	// 				scan_start(true);
	// 				return false;
	// 			}
	// 			//LOG_INF("Checkpoint 5");
	// 			LOG_INF("JSON message: %s, Length: %i", message->valuestring, strlen(message->valuestring));
	// 			if(!strcmp(message->valuestring,"LedOn")){
	// 				LOG_INF("Checkpoint 6");
	// 				dk_set_led(DK_LED1, 0);
	// 				return false;
	// 			}
	// 			else if(!strcmp(message->valuestring,"LedOff")){
	// 				LOG_INF("Checkpoint 7");
	// 				dk_set_led(DK_LED1, 1);
	// 				return false;
	// 			}
	// 			else if(!strcmp(message->valuestring,"BLE_LED_ON")){
	// 				struct ble_event *ble_event = new_ble_event(strlen(message->valuestring));

	// 				ble_event->type = BLE_SEND;
					
	// 				char *address_ptr = "Placeholder"; //Finne ut hvordan man kan velge mellom to devicer.
	// 				char address_temp[17];
	// 				for(int i=0;i<17;i++){
	// 					address_temp[i]=address_ptr[i];
	// 				}
	// 				// ble_event->address = address_temp;
	// 				memcpy(ble_event->address, address_temp, 17);

	// 				memcpy(ble_event->dyndata.data, message->valuestring, strlen(message->valuestring));

	// 				EVENT_SUBMIT(ble_event);
	// 				return false;
	// 			}
	// 		}
	// 		return false;
	// 	}
	// 	else{
	// 		LOG_INF("Message is null");
	// 		return false;
	// 	}
	// 	//char addr[17] = event->address;

	// 	// led_on=!led_on;
		
	// 	// dk_set_led(DK_LED1, led_on);

	// 	LOG_INF("Message: %.*s",event->dyndata.size, event->dyndata.data);

	// 	return false;
	// }

	return false;
}

void main(void)
{	
	// int err;
	// battery_monitor_init();
	// if(err){
	// 	LOG_INF("Couldn't init battery monitor: %i", err);
	// }
	// uint8_t battery;
	// err = battery_monitor_read(&battery);
	// if(err){
	// 	LOG_INF("Couldn't read battery monitor: %i", err);
	// }
	// LOG_INF("Battery: %i", battery);
	
	// int err;
	// // if (err) {
	// // 	LOG_ERR("Could not initialize leds, err code: %d\n", err);
	// // 	return err;
	// // }

	if(event_manager_init()){
		LOG_INF("Well this sucks");
	}
	else{
		LOG_INF("All good");
	}
	// struct ble_event *test;
	// /*char test_string[17] ="Testing.........";
	// test->address=test_string;*/
	// EVENT_SUBMIT(test);
}

EVENT_LISTENER(app_module, event_handler);
EVENT_SUBSCRIBE_EARLY(app_module, cloud_event_abbr);
EVENT_SUBSCRIBE(app_module, ble_event);
```
