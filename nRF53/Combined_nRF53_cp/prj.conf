## CMakeLists.txt
```
#
# Copyright (c) 2018 Nordic Semiconductor ASA
#
# SPDX-License-Identifier: LicenseRef-Nordic-5-Clause
#

cmake_minimum_required(VERSION 3.13.1)

find_package(Zephyr REQUIRED HINTS $ENV{ZEPHYR_BASE})
project(ble_to_cloud_from_scratch)

# NORDIC SDK APP START
target_sources(app PRIVATE src/main.c)
# NORDIC SDK APP END

# Include source directory
target_include_directories(app PRIVATE src)

add_subdirectory(src/events)
add_subdirectory(src/modules)
add_subdirectory(src/led)
# add_subdirectory(src/watchdog)

# add_subdirectory_ifdef(CONFIG_WATCHDOG_APPLICATION src/watchdog)
```

## Kconfig
```
#
# Copyright (c) 2021 Nordic Semiconductor ASA
#
# SPDX-License-Identifier: LicenseRef-Nordic-5-Clause
#

menu "HIVE_HUB"
	
config BEE_COUNTER_NAME
	string "Name of your Bee Counter Device"
	default "ItsyBitsy"

config BEE_COUNTER_ENABLE
	bool "Enable if you want the device to connect to the Bee Counter"
	default y

#Add Broodminder address, if we figure out how to add an address

config BROODMINDER_WEIGHT_ENABLE
	bool "Enable if you want the device to scan for the Broodminder Weight"
	default y

config THINGY_CONNECTIONS
	int "Number of Thingy:52 in the hive"
	default 1

config BLE_TO_CLOUD_APP_VERSION
	string "Bluetooth to cloud application firmware version"
	default "0.0.0-development"

config BLE_TO_CLOUD_APP_VERSION_MAX_LEN
	int "Maximum length of application firmware version"
	default 150

endmenu

menu "Zephyr Kernel"
source "Kconfig.zephyr"
endmenu

module = APPLICATION_MODULE
module-str = Application module
source "subsys/logging/Kconfig.template.log_config"
```

## prj.conf
```kconfig
#Enable Event manager
CONFIG_EVENT_MANAGER=y
CONFIG_LINKER_ORPHAN_SECTION_PLACE=y

# Enable DK LED and Buttons library
CONFIG_DK_LIBRARY=y

### Broodminder section ###
CONFIG_BT=y
# CONFIG_BT_BROADCASTER=y
# CONFIG_BT_OBSERVER=y
CONFIG_BT_DEBUG_LOG=y
CONFIG_BT_CENTRAL=y
CONFIG_BT_SCAN=y
CONFIG_BT_SCAN_FILTER_ENABLE=y
CONFIG_BT_SCAN_ADDRESS_CNT=1
CONFIG_LOG=y

CONFIG_CBPRINTF_FP_SUPPORT=y

### Thingy section ###
# Enable the BLE stack with GATT Client configuration
CONFIG_BT=y
CONFIG_BT_CENTRAL=y
CONFIG_BT_SMP=y
CONFIG_BT_GATT_CLIENT=y

# Enable the BLE modules from NCS
CONFIG_BT_SCAN_UUID_CNT=1
CONFIG_BT_SCAN_NAME_CNT=3
CONFIG_BT_GATT_DM=y
CONFIG_HEAP_MEM_POOL_SIZE=4096

# This example requires more workqueue stack
CONFIG_SYSTEM_WORKQUEUE_STACK_SIZE=4096

# Enable bonding
CONFIG_BT_SETTINGS=y
CONFIG_FLASH=y
CONFIG_FLASH_PAGE_LAYOUT=y
CONFIG_FLASH_MAP=y
CONFIG_NVS=y
CONFIG_SETTINGS=y

### Peripheral section ###

# Enable the UART driver
CONFIG_UART_ASYNC_API=y
CONFIG_NRFX_UARTE0=y
CONFIG_SERIAL=y

CONFIG_GPIO=y

# Make sure printk is not printing to the UART console
CONFIG_CONSOLE=y
CONFIG_UART_CONSOLE=y

# CONFIG_HEAP_MEM_POOL_SIZE=2048

CONFIG_BT=y
CONFIG_BT_PERIPHERAL=y
CONFIG_BT_DEVICE_NAME="TeppanTest"
# CONFIG_BT_DEVICE_NAME="Andreas53Test"
CONFIG_BT_DEVICE_APPEARANCE=833
CONFIG_BT_MAX_CONN=10
CONFIG_BT_MAX_PAIRED=10

# Enable the NUS service
CONFIG_BT_NUS=y
CONFIG_BT_NUS_CLIENT=y

CONFIG_THINGY_NAME="Hive1"

# CONFIG_BROODMINDER_WEIGHT_ENABLE=n
# CONFIG_BEE_COUNTER_ENABLE=n
# CONFIG_THINGY_ENABLE=n
```

## src/main.c
```c
/*
 * Copyright (c) 2018 Nordic Semiconductor ASA
 *
 * SPDX-License-Identifier: LicenseRef-Nordic-5-Clause
 */
#define MODULE app_module

#include <zephyr.h>
#include <stdio.h>
#include <drivers/uart.h>
#include <string.h>
#include <logging/log.h>
#include <dk_buttons_and_leds.h>

#include <settings/settings.h>

#include <event_manager.h>

#include "events/thingy_event.h"
#include "events/bm_w_event.h"

#if defined(CONFIG_WATCHDOG_APPLICATION)
#include "watchdog.h"
#endif

LOG_MODULE_REGISTER(MODULE, CONFIG_APPLICATION_MODULE_LOG_LEVEL);

bool led_on;

static bool event_handler(const struct event_header *eh)
{	
	// if (is_cloud_event_abbr(eh)) {

	// 	struct cloud_event_abbr *event = cast_cloud_event_abbr(eh);
	// 	cJSON *obj = NULL;
	// 	obj = cJSON_Parse(event->dyndata.data);
	// 	cJSON *message = cJSON_GetObjectItem(obj, "message");
	// 	if(message!=NULL){
	// 		if(message->valuestring!=NULL){
	// 			if(message->valuestring[0]=='*'){
	// 				LOG_INF("Should be sent to BLE");
	// 				struct ble_event *ble_event_routed = new_ble_event(strlen(message->valuestring));

	// 				ble_event_routed->type = BLE_SEND;
					
	// 				// char *address_ptr = "Placeholder"; //Finne ut hvordan man kan velge mellom to devicer.
	// 				// char address_temp[17];
	// 				// for(int i=0;i<17;i++){
	// 				// 	address_temp[i]=address_ptr[i];
	// 				// }
	// 				char addr[2];
	// 				addr[0]=message->valuestring[0];
	// 				addr[1]=message->valuestring[1];
	// 				// ble_event->address = address_temp;
	// 				memcpy(ble_event_routed->address, addr, 2);

	// 				memcpy(ble_event_routed->dyndata.data, message->valuestring, strlen(message->valuestring));

	// 				EVENT_SUBMIT(ble_event_routed);
	// 				return false;
	// 			}
	// 			if(!strcmp(message->valuestring, "StartScan")){
	// 				scan_start(true);
	// 				return false;
	// 			}
	// 			//LOG_INF("Checkpoint 5");
	// 			LOG_INF("JSON message: %s, Length: %i", message->valuestring, strlen(message->valuestring));
	// 			if(!strcmp(message->valuestring,"LedOn")){
	// 				LOG_INF("Checkpoint 6");
	// 				dk_set_led(DK_LED1, 0);
	// 				return false;
	// 			}
	// 			else if(!strcmp(message->valuestring,"LedOff")){
	// 				LOG_INF("Checkpoint 7");
	// 				dk_set_led(DK_LED1, 1);
	// 				return false;
	// 			}
	// 			else if(!strcmp(message->valuestring,"BLE_LED_ON")){
	// 				struct ble_event *ble_event = new_ble_event(strlen(message->valuestring));

	// 				ble_event->type = BLE_SEND;
					
	// 				char *address_ptr = "Placeholder"; //Finne ut hvordan man kan velge mellom to devicer.
	// 				char address_temp[17];
	// 				for(int i=0;i<17;i++){
	// 					address_temp[i]=address_ptr[i];
	// 				}
	// 				// ble_event->address = address_temp;
	// 				memcpy(ble_event->address, address_temp, 17);

	// 				memcpy(ble_event->dyndata.data, message->valuestring, strlen(message->valuestring));

	// 				EVENT_SUBMIT(ble_event);
	// 				return false;
	// 			}
	// 		}
	// 		return false;
	// 	}
	// 	else{
	// 		LOG_INF("Message is null");
	// 		return false;
	// 	}

	return false;
}

void main(void)
{	
	// int err = dk_leds_init();
	// dk_set_leds_state(DK_ALL_LEDS_MSK, 0);
	// if (err) {
	// 	LOG_ERR("Could not initialize leds, err code: %d\n", err);
	// 	return err;
	// }
	int err;
	if(event_manager_init()){
		LOG_INF("Well this sucks");
	}
	else{
		LOG_INF("All good");
	}

	// #if defined(CONFIG_WATCHDOG_APPLICATION)
	err = watchdog_init_and_start();
	if (err) {
		LOG_INF("watchdog_init_and_start, error: %d", err);
		// SEND_ERROR(app, APP_EVT_ERROR, err);
	}
	LOG_INF("watchdog_init_and_start successful.");
	// #endif	
	
	// struct ble_event *test;
	// /*char test_string[17] ="Testing.........";
	// test->address=test_string;*/
	// EVENT_SUBMIT(test);
}

EVENT_LISTENER(app_module, event_handler);
EVENT_SUBSCRIBE(app_module, thingy_event);
EVENT_SUBSCRIBE(app_module, bm_w_event);
```
